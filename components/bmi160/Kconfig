## components/bmi160/Kconfig
```kconfig
menu "BMI160"

    menu "SPI"
        config BMI160_SPI_MISO_PIN
            int "MISO pin"
            range 0 19
            default 2

        config BMI160_SPI_MOSI_PIN
            int "MOSI pin"
            range 0 19
            default 7

        config BMI160_SPI_SCLK_PIN
            int "SCLK pin"
            range 0 19
            default 6

        config BMI160_SPI_CS_PIN
            int "Chip select pin"
            range 0 19
            default 10

        config BMI160_SPI_CLOCK_HZ
            int "Clock frequency for the SPI connection in HZ"
            range 0 10000000
            default 10000000
    endmenu

endmenu
```

## components/bmi160/examples/stream_data/main/Kconfig.projbuild
```kconfig
menu "App config"

    menu "WIFI"
        config WIFI_AP_SSID
            string "Access point SSID"

        config WIFI_AP_PASSWORD
            string "Access point password"
    endmenu

    menu "TCP server"
        config TCP_PORT
            int "TCP port"
            default 3333
    endmenu

endmenu
```

## components/glowy_comms/Kconfig.projbuild
```kconfig
menu "Communication"

    config DEVICE_NAME
        string "Name of the BLE device"
        default "glowy"

    config USE_RANDOM_ADDRESS
        bool "Use random BLE address"
        default n

endmenu
```

## components/glowy_led/Kconfig.projbuild
```kconfig
menu "LED config"

    config GLOWY_LED_GPIO
        int "LED GPIO number"
        range 0 19
        default 0

    config GLOWY_LED_NUM
        int "Number of LEDS"
        default 1

endmenu
```

## components/glowy_script/Kconfig.projbuild
```kconfig
menu "Scripting"

    config SCRIPT_INPUT_BUFFER_SIZE
        int "Size of the input buffer"
        help
            Size of the buffer where input to the scripting module will be copied.
            Must be large enough to fit any input that may be given to the scripting module.

endmenu
```

## components/glw_comms/Kconfig.projbuild
```kconfig
menu "Communication"

    config DEVICE_NAME
        string "Name of the BLE device"
        default "glowie"

    config USE_RANDOM_ADDRESS
        bool "Use random BLE address"
        default n

    config COMMS_SCRIPT_IN_BUFFER_SIZE
        int "Size of the script input buffer"
        default 252

endmenu
```

## components/glw_led/Kconfig.projbuild
```kconfig
menu "LED config"

    config GLW_LED_GPIO
        int "LED GPIO number"
        range 0 19
        default 0

    config GLW_LED_NUM
        int "Number of LEDS"
        default 1

endmenu
```
